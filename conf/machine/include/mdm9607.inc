## conf/machine/include/mdm9607.inc
```bitbake
SOC_FAMILY = "mdm9607"
require conf/machine/include/soc-family.inc
require conf/machine/include/tune-cortexa8.inc

PREFERRED_PROVIDER_virtual/kernel ?= "linuxmdm"

MACHINE_EXTRA_RRECOMMENDS += " \
    fastrpc \
"

QCOM_BOOTIMG_KERNEL_BASE ?= "0x80000000"
QCOM_BOOTIMG_PAGE_SIZE ?= "2048"

# Uncomment the following line to enable the hard floating point abi. Note that
# this breaks some binary libraries and 3D (neither of which ship with
# meta-yocto). For maximum compatibility, leave this disabled.
#DEFAULTTUNE ?= "cortexa8hf-neon"

# Image Generation
# Make ubi filesystem and then pack it in a ubi container, as stock
IMAGE_FSTYPES ?= "ubi multiubi "

# Set the volume name inside the ubi image
UBI_VOLNAME = "rootfs"
ROOT_FLASH_SIZE = "63"
SYSTEM_VOLUME_SIZE ?= "63MiB"
CACHE_VOLUME_SIZE ?= "55MiB"

# Max supported inodes
EXTRA_IMAGECMD ?= "-N 2048"

MKUBIFS_ARGS="-m 2048 -e 126976 -c 4292 -F"
UBINIZE_ARGS="-m 2048 -p 128KiB -s 2048"
```

## conf/machine/include/mdm9640.inc
```bitbake
SOC_FAMILY = "mdm9640"
MACHINE = "mdm9640"
require conf/machine/include/soc-family.inc
require conf/machine/include/arm/armv7a/tune-cortexa8.inc

QCOM_BOOTIMG_KERNEL_BASE = "0x81808000"
QCOM_BOOTIMG_PAGE_SIZE = "4096"
KERNEL_TAGS_ADDR = "0x88000000"
BOARD_KERNEL_TAGS_OFFSET = "0x88000000"

# Uncomment the following line to enable the hard floating point abi. Note that
# this breaks some binary libraries and 3D (neither of which ship with
# meta-yocto). For maximum compatibility, leave this disabled.
#DEFAULTTUNE ?= "cortexa8hf-neon"

# Image Generation
# Make ubi filesystem and then pack it in a ubi container, as stock
IMAGE_FSTYPES ?= "ubi multiubi ext3.gz cpio.gz"

# Set the volume name inside the ubi image
UBI_VOLNAME = "rootfs"
ROOT_FLASH_SIZE = "63"
SYSTEM_VOLUME_SIZE ?= "63MiB"
CACHE_VOLUME_SIZE ?= "55MiB"

# Max supported inodes
EXTRA_IMAGECMD ?= "-N 4096"

MKUBIFS_ARGS="-m 2048 -e 126976 -c 4292 -F"
UBINIZE_ARGS="-m 2048 -p 128KiB -s 4096"
```

## conf/machine/mdm9607.conf
```bitbake
#@TYPE: Machine
#@NAME: MDM9607 MTP
#@DESCRIPTION: Machine configuration for QTI MDM9607 MTP

require conf/machine/include/mdm9607.inc

PREFERRED_PROVIDER_virtual/kernel ?= "linuxmdm"
MACHINE_FEATURES = "usbhost usbgadget ubifs"

KERNEL_IMAGETYPE = "zImage"
KERNEL_DTS_NAME = "mdm9607"
KERNEL_DEFCONFIG ?= "mdm9607-perf_defconfig"
KERNEL_DEVICETREE ?= "qcom/mdm9607-mtp.dtb"


# I don't know if these are actually used
BOARD_KERNEL_TAGS_OFFSET = "0x81E00000"
KERNEL_DEFCONFIG = "${S}/arch/arm/configs/mdm9607-perf_defconfig"
KERNEL_PERF_DEFCONFIG = "${S}/arch/arm/configs/mdm9607-perf_defconfig"
KERNEL_CMDLINE = "ro androidboot.hardware=qcom ehci-hcd.park=3 msm_rtb.filter=0x37 lpm_levels.sleep_disabled=1"

# Serial console - Using the high speed uart to debug until usb works
SERIAL_CONSOLE ?= "115200 ttyHSL0"
```

## conf/machine/mdm9640.conf
```bitbake
#@TYPE: Machine
#@NAME: mdm9640 MTP
#@DESCRIPTION: Machine configuration for QTI mdm9640 MTP

require conf/machine/include/mdm9640.inc

PREFERRED_PROVIDER_virtual/kernel ?= "linuxmdm"
MACHINE_FEATURES = "usbhost usbgadget ubifs"

KERNEL_IMAGETYPE = "zImage"
KERNEL_DTS_NAME = "mdm9640"

# I don't know if these are actually used
KERNEL_DEFCONFIG = "${S}/arch/arm/configs/mdm9640-perf_defconfig"
KERNEL_PERF_DEFCONFIG = "${S}/arch/arm/configs/mdm9640-perf_defconfig"
KERNEL_DEVICETREE ?= "qcom/mdm9640-v2-mtp.dtb"
KERNEL_CMDLINE = "noinitrd ro console=ttyHSL0,115200,n8 androidboot.hardware=qcom ehci-hcd.park=3 msm_rtb.filter=0x37 lpm_levels.sleep_disabled=1"

# Serial console - Using the high speed uart to debug until usb works
SERIAL_CONSOLE ?= "115200 ttyHSL0"
```
